## config/boards/shields/mage-hands/Kconfig.defconfig
```kconfig
if SHIELD_MAGE_HAND_LEFT

# Name must be less than 16 characters long!
config ZMK_KEYBOARD_NAME
    default "Mage Hands"

config ZMK_SPLIT_ROLE_CENTRAL
    default y

config PMW3610
    default y
endif

config ZMK_RGB_UNDERGLOW
    default y
    imply WS2812_STRIP

#if SHIELD_MAGE_HAND_LEFT || SHIELD_MAGE_HAND_RIGHT

#    config ZMK_SPLIT
#        default y

#    config SHIELD_TRACKBALL
#        bool "PMW3610 trackball"
#        imply SPI
#        imply PMW3610
#        imply ZMK_POINTING
#        imply ZMK_POINTING_SMOOTH_SCROLLING
#        depends on DT_HAS_PIXART_PMW3610_ENABLED
        
#    config SHIELD_UNDERGLOW
#        bool "Per-key RGB"
#        imply SPI
#        imply WS2812_STRIP
#        imply ZMK_RGB_UNDERGLOW
#        # imply ZMK_RGB_UNDERGLOW_EXT_POWER
#        depends on DT_HAS_WORLDSEMI_WS2812_SPI_ENABLED
        
#    config SHIELD_SCREEN #TODO: more features
#        bool "Nice View"
#        imply SPI
#        imply ZMK_DISPLAY
#        #imply ZMK_DISPLAY_WORK_QUEUE_DEDICATED
#        depends on DT_HAS_SHARP_LS0XX_ENABLED

#endif


if SHIELD_MAGE_HAND_LEFT || SHIELD_MAGE_HAND_RIGHT

    config ZMK_SPLIT
        default y

    config ZMK_SLEEP
        default y

    config ZMK_POINTING
        default y

    config ZMK_POINTING_SMOOTH_SCROLLING
        default n

    config SPI
        default y

    config PMW3610
        default y

    config PMW3610_SWAP_XY
        default y

    config PMW3610_REPORT_INTERVAL_MIN
        default 8

    config ZMK_RGB_UNDERGLOW_EXT_POWER
        default n

    config ZMK_KSCAN_MATRIX_WAIT_BEFORE_INPUTS
        default 0

    config ZMK_KSCAN_MATRIX_WAIT_BETWEEN_OUTPUTS
        default 1


endif
```

## config/boards/shields/mage-hands/Kconfig.shield
```kconfig
# No whitespace after the comma or in your part name!
config SHIELD_MAGE_HAND_LEFT
    def_bool $(shields_list_contains,mage_hand_left)

# No whitespace after the comma or in your part name!
config SHIELD_MAGE_HAND_RIGHT
    def_bool $(shields_list_contains,mage_hand_right)
```

## config/west.yml
```yaml
manifest:
  remotes:
    - name: zmkfirmware
      url-base: https://github.com/zmkfirmware
    # Additional modules containing boards/shields/custom code can be listed here as well
    # See https://docs.zephyrproject.org/3.2.0/develop/west/manifest.html#projects
    - name: inorichi
      url-base: https://github.com/inorichi
  projects:
    - name: zmk
      remote: zmkfirmware
      revision: main
      import: app/west.yml
    - name: zmk-pmw3610-driver
      remote: inorichi
      revision: main
  self:
    path: config
```
